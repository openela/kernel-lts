## Documentation/devicetree/bindings/arm/msm/qcom,osm.txt
```
Qualcomm Technologies, Inc. OSM Bindings

Operating State Manager (OSM) is a hardware engine used by some Qualcomm
Technologies, Inc. (QTI) SoCs to manage frequency and voltage scaling
in hardware. OSM is capable of controlling frequency and voltage requests
for multiple clusters via the existence of multiple OSM domains.

Properties:
- compatible
	Usage:      required
	Value type: <string>
	Definition: must be "qcom,clk-cpu-osm" or "qcom,clk-cpu-osm-sdmshrike"
			or "qcom,clk-cpu-osm-sm6150" or
			"qcom,clk-cpu-osm-sdmmagpie" or
			"qcom,clk-cpu-osm-trinket" or
			"qcom,clk-cpu-osm-atoll".

- reg
	Usage:      required
	Value type: <prop-encoded-array>
	Definition: Addresses and sizes for the memory of the OSM controller.

- reg-names
	Usage:      required
	Value type: <stringlist>
	Definition: Address names. Must be "osm_l3_base", "osm_pwrcl_base",
		    and "osm_perfcl_base". Can optionally have
		    "osm_perfpcl_base".
		    Must be specified in the same order as the corresponding
		    addresses are specified in the reg property.

- l3-devs
	Usage: optional
	Value type: <phandle>
	Definition: List of phandles to devices that the OPP tables with the L3
		    frequency and voltage mappings are loaded for.

- qcom,cpufreq-table-XX
	Usage: optional
	Value type: <u32>
	Definition: List of frequencies (in kHz) to expose in CPU XX's cpufreq table.
		    All frequencies present in hardware will be exposed if this list
		    is not present.

Example:
	clock_cpucc: qcom,cpucc {
		compatible = "qcom,clk-cpu-osm";
		reg = <0x18321000 0x1400>,
			<0x18323000 0x1400>,
			<0x18325800 0x1400>,
			<0x18327800 0x1400>;
		reg-names = "osm_l3_base", "osm_pwrcl_base",
			"osm_perfcl_base", "osm_perfpcl_base";

		l3-devs = <&phandle0 &phandle1 &phandle2>;

		#clock-cells = <1>;
		qcom,cpufreq-table-0 =
			< 300000>,
			< 403200>,
			< 480000>,
			< 576000>,
			< 672000>,
			< 768000>,
			< 864000>,
			< 979200>,
			<1075200>,
			<1171200>,
			<1267200>;

		qcom,cpufreq-table-4 =
			< 576000>,
			< 672000>,
			< 768000>,
			< 864000>,
			< 960000>,
			<1056000>,
			<1152000>,
			<1248000>,
			<1344000>,
			<1420800>,
			<1497600>,
			<1593600>,
			<1689600>,
			<1785600>,
			<1862400>,
			<1939200>,
			<2016000>;

		qcom,cpufreq-table-7 =
			< 691200>,
			< 768000>,
			< 864000>,
			< 940800>,
			<1017600>,
			<1113600>,
			<1190400>,
			<1286400>,
			<1363200>,
			<1459200>,
			<1536000>,
			<1632000>,
			<1728000>,
			<1824000>,
			<1900800>,
			<1977600>,
			<2054400>;
	};
```

## Kconfig
```kconfig
# SPDX-License-Identifier: GPL-2.0
#
# For a description of the syntax of this configuration file,
# see Documentation/kbuild/kconfig-language.txt.
#
mainmenu "Linux/$ARCH $KERNELVERSION Kernel Configuration"

config OPLUS_SYSTEM_KERNEL_QCOM
  bool "config oplus system feature "
  default y
  help
	define this config to Distinguish between qcom and mtk platform

config SRCARCH
	string
	option env="SRCARCH"

source "arch/$SRCARCH/Kconfig"

source "techpack/Kconfig"
```

## drivers/input/oppo_fp_drivers/Kconfig
```kconfig
menuconfig OPPO_FINGERPRINT
	bool "OPLUS fingerprint"
	depends on SPI_MASTER
	help
	  Say Y here to enable OPLUS fingerprint support

if OPPO_FINGERPRINT
### platform config
config OPPO_FINGERPRINT_QCOM
       default n
       tristate "Fingerprint base on QCOM"

config OPPO_FINGERPRINT_MTK
       default n
       tristate "Fingerprint base on MTK"

### fingerprint sensor config
config OPPO_FINGERPRINT_GOODIX_OPTICAL
       default n
       tristate "Fingerprint base on goodix optical chip"
endif #OPPO_FINGERPRINT
```

## drivers/input/touchscreen/oppo_touchscreen/Kconfig
```kconfig
config TOUCHPANEL_MTK_PLATFORM
	bool "OPPO platform tp module used"
	help
	  Say Y here if you have mtk-platform.

config TOUCHPANEL_LATE_INIT
	bool "mk6360 pmic init"
	help
	  Say Y here if you have mk6360 pmic.

config TOUCHIRQ_UPDATE_QOS
	bool "OPPO touchpanel driver update qos"
	help
	  Say Y here if you want to update qos value in irq handler.

config TOUCHPANEL_NEW_SET_IRQ_WAKE
	bool "OPPO platform tp module used"
	help
	  Say Y here if call enable_irq_wake, can not call disable_irq_nosync

config TOUCHPANEL_OPPO
	bool "OPPO tp module"
	help
	  Say Y here if you have touchscreen module.

config OPPO_TP_APK
	bool "OPPO apk node create"
	help
	  Say Y here if you use apk for TP.

config TOUCHPANEL_ALGORITHM
	bool "touch alogoritm in driver support"
	help
	  Say Y here if you use touch alogoritm in driver.

config TOUCHPANEL_MULTI_NOFLASH
	bool "Multiple noflash TPs using"
	help
	  Say Y here if you have multiple noflash touchscreen.

config TOUCHPANEL_SYNAPTICS
#	default y
	bool "TP Synaptics_IC enable or not for OPPO"
	---help---
	say Y to enable driver for Touchpanel using Synaptics_IC
	
source "drivers/input/touchscreen/oppo_touchscreen/util_interface/Kconfig"

if TOUCHPANEL_SYNAPTICS
source "drivers/input/touchscreen/oppo_touchscreen/Synaptics/Kconfig"
endif
```

## drivers/nfc/oppo_nfc/Kconfig
```kconfig
config OPPO_NFC
  bool "config oppo nfc chipset"
  default y
  help
	define this config to get chipset version from dts.
```

## drivers/soc/oplus/Kconfig
```kconfig
#wen.luo@BSP.Kernel.Stability 2020/03/25 add for oplus kernel system
source "drivers/soc/oplus/system/Kconfig"
#endif /* VENDOR_EDIT */

#ifdef OPLUS_FEATURE_TP_BASIC
#Qingwen.Liu@RM.BSP.Basic, 2020/11/03, Add for device info
source "drivers/soc/oplus/device_info/Kconfig"
#endif /* OPLUS_FEATURE_TP_BASIC */
```

## drivers/soc/oplus/device_info/Kconfig
```kconfig
config OPPO_DEVICE_IFNO
  bool "config oppo devinfo software"
  help
    define this config to compile devinfo.c for device register
```

## drivers/soc/oplus/sensor/Kconfig
```kconfig
config OPLUS_FEATURE_SENSOR_CFG
	tristate "oplus sensor share memory config"
	default y
	help
	  To compile this driver as a module, set M in kernel build config
	  module will be called oplus_sensor.
config SSC_INTERACTIVE
    bool "config ssc interactive"
    help
        define this config to send lcd info to slpi
```

## drivers/soc/oplus/system/Kconfig
```kconfig
# SPDX-License-Identifier: GPL-2.0-only
# Copyright (C) 2018-2020 Oplus. All rights reserved.
config OPLUS_SYSTEM_KERNEL
  bool "config oplus system feature "
  default y
  help
	define this config to add oplus sytstem kernel feature

config OPPO_ARCH_FILE
  bool "for build directory oppo"
  ---help---
  say Y to buid in

config OPPO_COMMON_SOFT
  bool "config oppo common software"
  select OPPO_ARCH_FILE
  help
	define this config to get project verion from sharemem.
	Maybe this value is from CDT or dynamic identify by hardware
	id.

config OPPO_DEVICE_IFNO
  bool "config oppo devinfo"
  select OPPO_ARCH_FILE
  help
	define this config to compile devinfo.c for device register
		.

source "drivers/soc/oplus/system/oplus_project/Kconfig"
source "drivers/soc/oplus/system/project_info/Kconfig"
```

## drivers/soc/oplus/system/oplus_project/Kconfig
```kconfig
#
#oppo project info configuration
#
config OPLUS_FEATURE_OPROJECT
  bool "config oplus project info for kernel"
  default n
  help
    define this config to define oplus project
```

## drivers/soc/oplus/system/project_info/Kconfig
```kconfig
# SPDX-License-Identifier: GPL-2.0-only
# Copyright (C) 2018-2020 Oplus. All rights reserved.
config OPLUS_FEATURE_PROJECTINFO
  bool "config oppo common software"
  default y
  help
	define this config to get project verion from sharemem.
	Maybe this value is from CDT or dynamic identify by hardware
	id.
```

## drivers/soc/oppo/Kconfig
```kconfig
config OPPO_ARCH_FILE
  bool "for build directory oppo"
  ---help---
  say Y to buid in

config OPPO_COMMON_SOFT
  bool "config oppo common software"
  select OPPO_ARCH_FILE
  help
  define this config to get project verion from sharemem.
  Maybe this value is from CDT or dynamic identify by hardware
  id.

source "drivers/soc/oppo/project_info/Kconfig"
```

## drivers/soc/oppo/project_info/Kconfig
```kconfig
config OPPO_COMMON_SOFT
  bool "config oppo common software"
  help
	define this config to get project verion from sharemem.
	Maybe this value is from CDT or dynamic identify by hardware
	id.
```
